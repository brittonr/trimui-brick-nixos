## firmware/trimui-brick_defconfig
```kconfig
# TrimUI Brick (TG3040) — Allwinner A133 with LPDDR3
# Based on liontron-h-a133l_defconfig with TrimUI DRAM timings
CONFIG_ARM=y
CONFIG_ARCH_SUNXI=y
CONFIG_DEFAULT_DEVICE_TREE="allwinner/sun50i-a133-liontron-h-a133l"
CONFIG_SPL=y
CONFIG_MACH_SUN50I_A133=y

# DRAM: LPDDR3 @ 672 MHz (Liontron uses LPDDR4 @ 792 MHz)
CONFIG_SUNXI_DRAM_A133_LPDDR3=y
CONFIG_DRAM_CLK=672
CONFIG_DRAM_SUNXI_DX_ODT=0x6060606
CONFIG_DRAM_SUNXI_DX_DRI=0xc0c0c0c
CONFIG_DRAM_SUNXI_CA_DRI=0x1919
CONFIG_DRAM_SUNXI_ODT_EN=0x1
CONFIG_DRAM_SUNXI_PARA0=0x30fa
CONFIG_DRAM_SUNXI_MR11=0x15
CONFIG_DRAM_SUNXI_MR12=0x83
CONFIG_DRAM_SUNXI_MR13=0x1c
CONFIG_DRAM_SUNXI_MR14=0x2
CONFIG_DRAM_SUNXI_TPR0=0x0
CONFIG_DRAM_SUNXI_TPR1=0x16161a1e
CONFIG_DRAM_SUNXI_TPR2=0x80000000
CONFIG_DRAM_SUNXI_TPR3=0x0
CONFIG_DRAM_SUNXI_TPR6=0x0
CONFIG_DRAM_SUNXI_TPR10=0x2fbbdf
CONFIG_DRAM_SUNXI_TPR11=0x19170f0f
CONFIG_DRAM_SUNXI_TPR12=0xf111110
CONFIG_DRAM_SUNXI_TPR13=0x7521
CONFIG_DRAM_SUNXI_TPR14=0x1e1e2020

# Debug UART — A133 UART0 at 0x05000000, reg-shift=2
CONFIG_DEBUG_UART=y
CONFIG_DEBUG_UART_NS16550=y
CONFIG_DEBUG_UART_BASE=0x05000000
CONFIG_DEBUG_UART_CLOCK=24000000
CONFIG_DEBUG_UART_SHIFT=2
CONFIG_DEBUG_UART_ANNOUNCE=y

# SD/eMMC
CONFIG_MMC_SUNXI_SLOT_EXTRA=2
CONFIG_SUPPORT_EMMC_BOOT=y

# I2C/PMIC — AXP803 config inherited from Liontron reference board.
# TrimUI Brick has AXP2202, but vendor boot0 handles PMIC init, so these
# only affect the unused mainline SPL path. The AXP803 driver is disabled
# in the DTB overlay to prevent wrong register writes at runtime.
CONFIG_R_I2C_ENABLE=y
CONFIG_SPL_I2C=y
CONFIG_SPL_SYS_I2C_LEGACY=y
CONFIG_SYS_I2C_MVTWSI=y
CONFIG_SYS_I2C_SLAVE=0x7f
CONFIG_SYS_I2C_SPEED=400000
CONFIG_AXP803_POWER=y
CONFIG_AXP_DCDC5_VOLT=1100

# USB
CONFIG_USB_EHCI_HCD=y
CONFIG_USB_OHCI_HCD=y

# Performance
# CONFIG_SYS_MALLOC_CLEAR_ON_INIT is not set
```
